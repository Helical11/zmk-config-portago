## boards/shields/portago9/Kconfig.defconfig
```kconfig
if SHIELD_MY_KEYBOARD_DONGLE

config ZMK_KEYBOARD_NAME
    default "portago9"

config ZMK_SPLIT_ROLE_CENTRAL
    default y

config ZMK_SPLIT
    default y

config ZMK_SPLIT_BLE_CENTRAL_PERIPHERALS
    default 1

config BT_MAX_CONN
    default 6

config BT_MAX_PAIRED
    default 6

endif
```

## boards/shields/portago9/Kconfig.shield
```kconfig
config SHIELD_PORTAGO9_BODY
    def_bool $(shields_list_contains,portago9_body)

config SHIELD_PORTAGO9_DONGLE
    def_bool $(shields_list_contains,portago9_dongle)
```
